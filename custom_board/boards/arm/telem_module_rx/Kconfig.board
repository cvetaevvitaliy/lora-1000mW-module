## custom_board/boards/arm/telem_module_rx/Kconfig.board
```kconfig
# board configuration
# Copyright (c) 2021, Vitaliy Nimych <vitaliy.nimych@gmail.com>
# SPDX-License-Identifier: Apache-2.0

config BOARD_TELEM_MODULE_RX
	bool "Telemetry module RX board"
	depends on SOC_STM32F405XG
```

## custom_board/boards/arm/telem_module_rx/Kconfig.defconfig
```kconfig
# board configuration
# Copyright (c) 2021, Vitaliy Nimych <vitaliy.nimych@gmail.com>
# SPDX-License-Identifier: Apache-2.0

if BOARD_TELEM_MODULE_RX

config BOARD
	default "telem_module_rx"

endif # BOARD
```

## custom_board/boards/arm/telem_module_tx/Kconfig.board
```kconfig
# OLIMEX-STM32-P405 board configuration
# Copyright (c) 2021, Vitaliy Nimych <vitaliy.nimych@gmail.com>
# SPDX-License-Identifier: Apache-2.0

config BOARD_TELEM_MODULE_TX
	bool "Telemetry module TX board"
	depends on SOC_STM32F405XG
```

## custom_board/boards/arm/telem_module_tx/Kconfig.defconfig
```kconfig
# board configuration

# Copyright (c) 2021, Vitaliy Nimych <vitaliy.nimych@gmail.com>
# SPDX-License-Identifier: Apache-2.0

if BOARD_TELEM_MODULE_TX

config BOARD
	default "telem_module_tx"

endif # BOARD
```
